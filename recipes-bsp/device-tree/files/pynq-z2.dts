// SPDX-License-Identifier: GPL-2.0+
// Compile entry point only — all board/PL content lives in pynq-z2-pl.dtsi.
// zynq-7000.dtsi resolves from the kernel source tree via KERNEL_INCLUDE
// (see device-tree.bbappend). Include order matters: SoC base first, then
// our overlay which references its labels (&amba, &uart0, ...).
/dts-v1/;
#include "zynq-7000.dtsi"
#include "pynq-z2-pl.dtsi"
